## boards/arm/piantor_pro_bt/piantor_pro_bt_left_defconfig
```kconfig
# SPDX-License-Identifier: MIT

CONFIG_SOC_SERIES_NRF52X=y
CONFIG_SOC_NRF52840_QIAA=y
CONFIG_BOARD_PIANTOR_PRO_BT_LEFT=y

# Enable deep sleep
CONFIG_ZMK_SLEEP=y
CONFIG_ZMK_IDLE_SLEEP_TIMEOUT=3600000

# Enable MPU
CONFIG_ARM_MPU=y

# Enable GPIO
CONFIG_GPIO=y

CONFIG_USE_DT_CODE_PARTITION=y
CONFIG_BUILD_OUTPUT_UF2=y

CONFIG_MPU_ALLOW_FLASH_WRITE=y
CONFIG_NVS=y
CONFIG_SETTINGS_NVS=y
CONFIG_FLASH=y
CONFIG_FLASH_PAGE_LAYOUT=y
CONFIG_FLASH_MAP=y

CONFIG_ZMK_USB=y
CONFIG_ZMK_BLE=y

# Enable I2C
CONFIG_I2C=y
CONFIG_I2C_NRFX=y
CONFIG_PINCTRL=y

# Windows Battery Reporting Fix
CONFIG_BT_GATT_ENFORCE_SUBSCRIPTION=n

# BlueTooth config
CONFIG_BT_CTLR_TX_PWR_PLUS_8=n
CONFIG_BT_MAX_CONN=5
CONFIG_BT_MAX_PAIRED=5

# Enable ZMK Studio (alpha)
CONFIG_ZMK_STUDIO=y
```

## config/west.yml
```yaml
manifest:
  remotes:
    - name: zmkfirmware
      url-base: https://github.com/zmkfirmware
    - name: infely                             # niceViewBattery
      url-base: https://github.com/infely      # niceViewBattery
    # Additional modules containing boards/shields/custom code can be listed here as well
    # See https://docs.zephyrproject.org/3.2.0/develop/west/manifest.html#projects
  projects:
    - name: zmk
      remote: zmkfirmware
      revision: main
      import: app/west.yml
    - name: nice-view-battery                  # niceViewBattery
      remote: infely                           # niceViewBattery
      revision: main                           # niceViewBattery
  self:
    path: config
```
